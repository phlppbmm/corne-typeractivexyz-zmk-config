## config/west.yml
```yaml
manifest:
  remotes:
    - name: zmkfirmware
      url-base: https://github.com/zmkfirmware
  projects:
    - name: zmk
      remote: zmkfirmware
      revision: f1b944b1efc01805a769cb2b15797c2c611bcc5f
      import: app/west.yml
  self:
    path: config
```
